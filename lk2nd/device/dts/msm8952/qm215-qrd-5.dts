// SPDX-License-Identifier: MIT

/dts-v1/;

#include <skeleton64.dtsi>
#include <lk2nd.dtsi>


/ {
	qcom,msm-id = <QCOM_ID_QM215 0>;
	qcom,board-id = <QCOM_BOARD_ID(QRD, 1, 0) 5>;
};

&lk2nd {
	nokia-weeknd {
		model = "Nokia 2780 Flip (nokia-weeknd)";
		compatible = "nokia,weeknd";
		// lk2nd,match-device = "cedric"; // TODO:

		lk2nd,dtb-files = "qm215-nokia-weeknd";
	};
};
